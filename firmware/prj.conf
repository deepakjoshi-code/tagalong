## CMakeLists.txt
```
# Zephyr application build for the Tagalong tag (nRF52840).
#
# This is the on-target build. The protocol and policy sources it pulls in are
# the same files the host tests in Makefile exercise, so what is tested is what
# ships. Requires nRF Connect SDK v2.6 or newer.
#
#   west build -b tagalong_nrf52840 tagalong/firmware
cmake_minimum_required(VERSION 3.20.0)

find_package(Zephyr REQUIRED HINTS $ENV{ZEPHYR_BASE})
project(tagalong)

target_include_directories(app PRIVATE include)

target_sources(app PRIVATE
  src/tagalong_protocol.c
  src/tagalong_policy.c
  # Board-dependent sources are added as they are written; see
  # docs/firmware/firmware-architecture.md for the intended module layout.
  # src/main.c
  # src/ble_service.c
  # src/event_engine.c
  # src/audio.c
  # src/power.c
)
```

## prj.conf
```kconfig
# Zephyr configuration for the Tagalong tag.
# Rationale for the non-obvious choices is in docs/firmware/firmware-architecture.md
# and the privacy requirements in docs/adr/ADR-007-ble-privacy-model.md.

# --- Bluetooth -------------------------------------------------------------
CONFIG_BT=y
CONFIG_BT_PERIPHERAL=y
CONFIG_BT_DEVICE_NAME="Tagalong"
CONFIG_BT_DEVICE_APPEARANCE=0
CONFIG_BT_MAX_CONN=1
CONFIG_BT_MAX_PAIRED=1

# LE Secure Connections with bonding. Config and Control characteristics require
# encryption, so an unbonded phone can never reconfigure a child's tag.
CONFIG_BT_SMP=y
CONFIG_BT_SMP_SC_PAIR_ONLY=y
CONFIG_BT_BONDABLE=y
CONFIG_BT_SETTINGS=y

# Resolvable private addresses, rotated, so the tag cannot be used to follow a
# child between places (ADR-007).
CONFIG_BT_PRIVACY=y
CONFIG_BT_RPA_TIMEOUT=900

CONFIG_BT_GATT_DYNAMIC_DB=n
CONFIG_BT_ATT_PREPARE_COUNT=2
CONFIG_BT_L2CAP_TX_MTU=65
CONFIG_BT_BUF_ACL_RX_SIZE=69

# --- Storage ---------------------------------------------------------------
CONFIG_FLASH=y
CONFIG_FLASH_MAP=y
CONFIG_NVS=y
CONFIG_SETTINGS=y
CONFIG_SETTINGS_NVS=y
# 16 MB QSPI NOR holds the content pack and the optional name clip.
CONFIG_NORDIC_QSPI_NOR=y
CONFIG_NORDIC_QSPI_NOR_FLASH_LAYOUT_PAGE_SIZE=4096

# --- Sensors ---------------------------------------------------------------
CONFIG_SENSOR=y
CONFIG_I2C=y
CONFIG_LIS2DW12=y
CONFIG_LIS2DW12_TRIGGER_GLOBAL_THREAD=y
CONFIG_ADC=y

# --- Audio -----------------------------------------------------------------
CONFIG_I2S=y
CONFIG_I2S_NRFX=y

# --- Power -----------------------------------------------------------------
CONFIG_PM=y
CONFIG_PM_DEVICE=y
CONFIG_PM_DEVICE_RUNTIME=y
# The 30-day battery target depends on the CPU being asleep between FIFO
# watermarks; see docs/hardware/power-budget.md.
CONFIG_SYS_CLOCK_TICKS_PER_SEC=1000

# --- Firmware update -------------------------------------------------------
CONFIG_BOOTLOADER_MCUBOOT=y
CONFIG_MCUBOOT_IMG_MANAGER=y
CONFIG_IMG_MANAGER=y
CONFIG_MCUMGR=y
CONFIG_MCUMGR_TRANSPORT_BT=y
CONFIG_MCUMGR_GRP_IMG=y
CONFIG_MCUMGR_GRP_OS=y

# --- Reliability -----------------------------------------------------------
CONFIG_WATCHDOG=y
CONFIG_REBOOT=y
CONFIG_RESET_ON_FATAL_ERROR=y

# --- Logging ---------------------------------------------------------------
# PRIVACY: logs must never contain a child's name, a recorded clip, or an event
# history. Release builds ship with logging off entirely.
CONFIG_LOG=y
CONFIG_LOG_DEFAULT_LEVEL=1
CONFIG_LOG_MODE_MINIMAL=y

# --- Size ------------------------------------------------------------------
CONFIG_MAIN_STACK_SIZE=2048
CONFIG_SYSTEM_WORKQUEUE_STACK_SIZE=2048
CONFIG_HEAP_MEM_POOL_SIZE=4096
CONFIG_NEWLIB_LIBC=n
```

## include/tagalong_events.h
```c
/*
 * Event engine — turns raw sensor blocks into the events the app knows about.
 *
 * Thresholds come from docs/hardware/sensing-and-event-detection.md; the state
 * machines are specified in docs/firmware/event-engine-spec.md. Everything here
 * is pure C99 with no RTOS or clock dependency: the caller supplies a monotonic
 * millisecond timestamp with each block, so the whole engine runs against
 * recorded traces on a laptop.
 *
 * Design rule from the brief: a false positive is worse than a missed event. A
 * bottle that says "ouch" when nothing happened breaks the illusion; a bottle
 * that misses one drop in ten is forgivable. When a classifier is unsure it
 * emits nothing.
 */
#ifndef TAGALONG_EVENTS_H
#define TAGALONG_EVENTS_H

#include "tagalong_protocol.h"

/** Accelerometer sample in milli-g per axis (1000 = 1 g). */
typedef struct {
    int16_t x, y, z;
} tag_accel_sample_t;

/** Sentinel for a sensor that is absent or not sampled in this block. */
#define TAG_CAP_NONE UINT16_MAX
#define TAG_LUX_NONE UINT16_MAX

/** One accelerometer FIFO block plus whatever slow sensors were read with it. */
typedef struct {
    uint32_t now_ms;                   /* monotonic, at the END of the block */
    const tag_accel_sample_t *samples; /* may be NULL when n == 0 */
    uint16_t n;
    uint16_t sample_rate_hz;
    uint16_t cap_raw;                  /* 0..1023, or TAG_CAP_NONE */
    uint16_t lux;                      /* 0..65534, or TAG_LUX_NONE */
} tag_sensor_block_t;

#define TAG_MAX_EVENTS_PER_BLOCK 4u

typedef struct {
    tag_event_type_t type;
    uint8_t aux; /* per docs/protocol: impact g x10, tilt degrees, or seconds/2 */
} tag_detected_event_t;

typedef struct {
    tag_detected_event_t items[TAG_MAX_EVENTS_PER_BLOCK];
    uint8_t count;
} tag_event_batch_t;

/* ---- Tunables, exposed so tests and the calibration rig can read them ---- */
#define TAG_FREEFALL_MILLI_G 350      /* |a| below this counts as falling */
#define TAG_FREEFALL_MIN_MS 30u
#define TAG_IMPACT_MILLI_G 2500       /* peak that must follow a fall */
#define TAG_IMPACT_WINDOW_MS 600u
#define TAG_STILL_VAR 10000u          /* (milli-g)^2 of |a| — below this is still */
#define TAG_MOVING_VAR 40000u         /* above this is definitely being handled */
#define TAG_PICKUP_CONFIRM_MS 640u
#define TAG_PUTDOWN_CONFIRM_MS 1600u
#define TAG_SHAKE_PEAK_MILLI_G 1200
#define TAG_SHAKE_MIN_CROSSINGS 4u
#define TAG_LONG_STILL_MS (45u * 60u * 1000u)
#define TAG_SIP_TILT_DEG 45
#define TAG_SIP_UPRIGHT_DEG 25
#define TAG_SIP_MIN_MS 800u
#define TAG_SIP_MAX_MS 6000u
#define TAG_FILL_RISE_PERCENT 18u     /* cap rise, in percent of learned span */
#define TAG_FILL_FULL_PERCENT 60u
#define TAG_EMPTY_PERCENT 8u
#define TAG_BRUSH_TARGET_MS 120000u   /* the famous two minutes */
#define TAG_BRUSH_SHORT_MIN_MS 15000u
#define TAG_BRUSH_GAP_MS 15000u       /* pause allowed inside one session */
#define TAG_LUX_OPEN 50u
#define TAG_LUX_DARK 5u
#define TAG_LEFT_BEHIND_MS (20u * 60u * 1000u)
/*
 * A transition older than this no longer counts towards "the room was busy".
 * It must exceed TAG_LEFT_BEHIND_MS, because the whole signature is "busy, then
 * quiet for twenty minutes" — a decay shorter than the stillness requirement
 * would clear the counter before the event could ever fire.
 */
#define TAG_TRANSITION_DECAY_MS (TAG_LEFT_BEHIND_MS + 20u * 60u * 1000u)
/* Leaving something behind only matters around leaving the house or school. */
#define TAG_LEFT_BEHIND_MORNING_START (7u * 60u)
#define TAG_LEFT_BEHIND_MORNING_END (9u * 60u)
#define TAG_LEFT_BEHIND_AFTERNOON_START (14u * 60u)
#define TAG_LEFT_BEHIND_AFTERNOON_END (17u * 60u)
/* A pause longer than this ends a brushing session. */
#define TAG_BRUSH_SESSION_RESET_MS (5u * 60u * 1000u)
#define TAG_BRUSH_MAX_SESSIONS_PER_DAY 2u
/*
 * Regular oscillation for this long means a vehicle, not a child. Kept short
 * because every block before confirmation is a chance to say something wrong.
 */
#define TAG_TRANSPORT_CONFIRM_MS 3000u
/* The engine's own shake debounce, so one wiggle is one event, not thirty. */
#define TAG_SHAKE_DEBOUNCE_MS 2000u

typedef enum {
    TAG_MOTION_STILL = 0,
    TAG_MOTION_HANDLED,
} tag_motion_state_t;

typedef struct {
    tag_thing_t thing;

    /* Motion */
    tag_motion_state_t motion;
    uint32_t state_since_ms;
    uint32_t last_motion_ms;
    uint32_t last_long_still_ms;
    bool transport_suppressed;
    /* Consecutive blocks that look like regular vibration rather than handling. */
    uint16_t oscillatory_blocks;

    /* Drop */
    uint32_t freefall_started_ms;
    uint32_t freefall_ended_ms;
    bool in_freefall;
    uint32_t last_drop_ms;
    uint32_t last_shake_ms;

    /* Bottle */
    uint16_t cap_baseline;   /* learned empty reading */
    uint16_t cap_span;       /* learned empty..full range, 0 until learned */
    uint16_t cap_level_pct;  /* last computed level */
    uint16_t cap_low_pct;    /* lowest level seen since the last fill */
    uint32_t cap_rise_start_ms;
    uint16_t cap_rise_from_pct;
    bool fill_armed;         /* a rise was seen, waiting for stillness */
    uint32_t last_fill_ms;

    /* Sip */
    bool tilted;
    uint32_t tilt_started_ms;
    int16_t tilt_peak_deg;
    uint16_t tilt_start_level_pct;

    /* Toothbrush */
    bool brushing;
    uint32_t brush_session_start_ms;
    uint32_t brush_last_active_ms;
    uint32_t brush_accum_ms;
    bool brush_announced_start;
    bool brush_announced_done;
    /* At most two announced sessions a day, so a child cannot farm celebrations. */
    uint8_t brush_sessions_today;

    /* Lunchbox */
    uint16_t last_lux;
    uint32_t dark_since_ms;
    bool lid_open;
    uint32_t last_lid_ms;

    /* Backpack */
    uint8_t recent_transitions;
    uint32_t last_transition_ms;
    uint32_t last_left_behind_ms;
    uint16_t last_left_behind_day_min;
    bool left_behind_today;

    /* Time of day, supplied by the app (the tag has no clock). */
    uint16_t minute_of_day;
    bool time_known;
    uint32_t time_set_at_ms;

    /* Boot settling: no events for the first TAG_WARMUP_MS. */
    uint32_t boot_ms;
    bool warm;
} tag_event_engine_t;

#define TAG_WARMUP_MS 20000u

void tag_events_init(tag_event_engine_t *e, tag_thing_t thing, uint32_t now_ms);

/**
 * Tells the engine what time it is. The app sends this on every connection
 * (ControlOp 0x04). Until it is called, events that only make sense at certain
 * times of day stay suppressed rather than firing at the wrong moment.
 */
void tag_events_set_time(tag_event_engine_t *e, uint16_t minute_of_day, uint32_t now_ms);

/**
 * Feeds one sensor block and returns everything detected in it.
 * Never returns more than TAG_MAX_EVENTS_PER_BLOCK; extra detections are dropped
 * rather than queued, because stale reactions are worse than missing ones.
 */
void tag_events_process(tag_event_engine_t *e, const tag_sensor_block_t *block,
                        tag_event_batch_t *out);

/** Magnitude of a sample in milli-g. */
uint16_t tag_accel_magnitude(const tag_accel_sample_t *s);

/** Angle of the sample from vertical, in degrees (0 = upright). */
int16_t tag_accel_tilt_degrees(const tag_accel_sample_t *s);

#endif /* TAGALONG_EVENTS_H */
```

## include/tagalong_policy.h
```c
/*
 * Utterance policy — the layer between "an event happened" and "make a sound".
 *
 * This is where a talking object becomes tolerable to live with: rate limiting,
 * quiet hours, mute, per-event debounce, a minimum gap so the tag never talks
 * over itself, and no-repeat phrase selection.
 *
 * Pure C99 with no time source of its own: callers pass a monotonic millisecond
 * clock, which makes every rule testable on the host.
 */
#ifndef TAGALONG_POLICY_H
#define TAGALONG_POLICY_H

#include "tagalong_protocol.h"

/** Minimum gap between two utterances. The tag never interrupts itself. */
#define TAG_MIN_GAP_MS 6000u

/** A pending event is held this long waiting for the gap, then dropped (still logged). */
#define TAG_PENDING_HOLD_MS 3000u

/** Utterances are never allowed above this, whatever the config says. */
#define TAG_MAX_PER_HOUR_CAP 30u

/** How many recently played clips to remember per cell, so lines don't repeat. */
#define TAG_RECENT_MEMORY 3u

typedef enum {
    TAG_SPEAK_ALLOW = 0,
    TAG_DENY_MUTED,
    TAG_DENY_QUIET_HOURS,
    TAG_DENY_RATE_LIMIT,
    TAG_DENY_DEBOUNCE,
    TAG_DENY_MIN_GAP,
    TAG_DENY_BATTERY_CRITICAL,
    TAG_DENY_NUDGES_OFF,
    TAG_DENY_UNKNOWN_EVENT
} tag_speak_decision_t;

typedef struct {
    /* Token bucket for the hourly rate limit, in milli-tokens for precision. */
    uint32_t tokens_milli;
    uint32_t tokens_updated_ms;
    /* When each event type last produced an utterance. 0 means never. */
    uint32_t last_event_ms[TAG_MAX_PER_HOUR_CAP > 0 ? 256 : 256];
    uint32_t last_utterance_ms;
    /* Recently played clip indices, newest last. */
    uint16_t recent[TAG_RECENT_MEMORY];
    uint8_t recent_count;
    /* Deterministic PRNG so tests are repeatable and the tag needs no entropy source. */
    uint32_t rng_state;
} tag_policy_t;

typedef struct {
    uint32_t now_ms;            /* monotonic since boot */
    uint16_t minute_of_day;     /* 0..1439, from the last app sync + RTC */
    uint8_t day_of_week;        /* 0 = Monday .. 6 = Sunday, or TAG_DAY_UNKNOWN */
    bool muted;
    uint8_t battery;            /* 0..100 */
} tag_policy_ctx_t;

/** Per-event debounce in milliseconds; see docs/hardware/sensing-and-event-detection.md. */
uint32_t tag_event_debounce_ms(tag_event_type_t type);

/** True for events that are only allowed when the parent has enabled nudges. */
bool tag_event_is_nudge(tag_event_type_t type);

void tag_policy_init(tag_policy_t *p, const tag_config_t *cfg, uint32_t now_ms, uint32_t seed);

/**
 * Decides whether `type` may be spoken now. Pure: it does not mutate `p`.
 * Call tag_policy_commit() only when the clip actually starts playing.
 */
tag_speak_decision_t tag_policy_check(const tag_policy_t *p, const tag_config_t *cfg,
                                      const tag_policy_ctx_t *ctx, tag_event_type_t type);

/** Records that an utterance for `type` started at ctx->now_ms. */
void tag_policy_commit(tag_policy_t *p, const tag_config_t *cfg, const tag_policy_ctx_t *ctx,
                       tag_event_type_t type);

/**
 * Picks a clip index in [0, count) avoiding the last TAG_RECENT_MEMORY choices.
 * Mirrors pickPhrase() in app/src/content/pickPhrase.ts. Returns 0 if count == 0.
 */
uint16_t tag_policy_pick_clip(tag_policy_t *p, uint16_t count);

/** Exposed for tests: xorshift32. */
uint32_t tag_policy_rand(tag_policy_t *p);

#endif /* TAGALONG_POLICY_H */
```

## include/tagalong_protocol.h
```c
/*
 * Tagalong BLE wire protocol — shared encode/decode.
 *
 * This is the C half of the contract in docs/protocol/tag-protocol.md. The app's
 * TypeScript implementation lives in app/src/transport/codec.ts and MUST produce
 * byte-identical frames; tests/test_protocol.c checks the vectors both sides agree on.
 *
 * Pure C99, no RTOS or libc dependencies beyond <stdint.h>/<stdbool.h>/<string.h>,
 * so it builds under Zephyr and runs in host unit tests unchanged.
 */
#ifndef TAGALONG_PROTOCOL_H
#define TAGALONG_PROTOCOL_H

#include <stdbool.h>
#include <stddef.h>
#include <stdint.h>

#define TAGALONG_PROTO_VERSION 1u
#define TAGALONG_CONFIG_LEN 16u
#define TAGALONG_INFO_LEN 12u
#define TAGALONG_EVENT_LEN 8u

/** Quiet hours are carried as minutes/10; 255 means disabled. */
#define TAGALONG_QUIET_DISABLED 255u
#define TAGALONG_QUIET_STEP 10u

typedef enum {
    TAG_BAND_LITTLE = 0,
    TAG_BAND_KID = 1,
    TAG_BAND_BIG = 2,
    TAG_BAND_COUNT = 3
} tag_age_band_t;

typedef enum {
    TAG_PERSONALITY_SILLY = 0,
    TAG_PERSONALITY_SWEET = 1,
    TAG_PERSONALITY_BRAVE = 2,
    TAG_PERSONALITY_COUNT = 3
} tag_personality_t;

typedef enum {
    TAG_THING_BOTTLE = 0,
    TAG_THING_LUNCHBOX = 1,
    TAG_THING_BACKPACK = 2,
    TAG_THING_TOOTHBRUSH = 3,
    TAG_THING_SHOES = 4,
    TAG_THING_PLUSH = 5,
    TAG_THING_HELMET = 6,
    TAG_THING_JACKET = 7,
    TAG_THING_OTHER = 255
} tag_thing_t;

typedef enum {
    TAG_LANG_EN = 0,
    TAG_LANG_ES = 1,
    TAG_LANG_HI = 2
} tag_language_t;

/* Event codes. Must match EVENT_META in app/src/domain/events.ts. */
typedef enum {
    TAG_EVT_PICKUP = 0,
    TAG_EVT_PUTDOWN = 1,
    TAG_EVT_DROP = 2,
    TAG_EVT_SHAKE = 3,
    TAG_EVT_TAP = 4,
    TAG_EVT_LONG_STILL = 5,
    TAG_EVT_GOOD_MORNING = 6,
    TAG_EVT_LOW_BATTERY = 7,
    TAG_EVT_CHARGING = 8,
    TAG_EVT_FILLED = 16,
    TAG_EVT_SIP = 17,
    TAG_EVT_EMPTY = 18,
    TAG_EVT_OPENED = 32,
    TAG_EVT_CLOSED = 33,
    TAG_EVT_PACKED = 34,
    TAG_EVT_LEFT_BEHIND = 48,
    TAG_EVT_ZIPPED = 49,
    TAG_EVT_BRUSH_START = 64,
    TAG_EVT_BRUSH_DONE = 65,
    TAG_EVT_BRUSH_SHORT = 66,
    TAG_EVT_NONE = 255
} tag_event_type_t;

/* Config flag bits (byte 8). */
#define TAG_FLAG_NUDGES (1u << 0)
#define TAG_FLAG_EVENT_BUFFER (1u << 1)
#define TAG_FLAG_NAME_CLIP (1u << 2)
#define TAG_FLAG_LED (1u << 3)

/* Info flag bits (byte 11). */
#define TAG_INFO_CHARGING (1u << 0)
#define TAG_INFO_MUTED (1u << 1)
#define TAG_INFO_NAME_CLIP (1u << 2)

typedef struct {
    uint8_t version;
    tag_age_band_t age_band;
    tag_thing_t thing;
    tag_personality_t personality;
    uint8_t volume;        /* 0..100 */
    bool quiet_enabled;
    uint16_t quiet_start_min; /* minutes since midnight, multiple of 10 */
    uint16_t quiet_end_min;
    tag_language_t language;
    uint8_t flags;
    uint8_t max_per_hour;  /* 1..30 */
    uint16_t time_of_day_min;
    /* Second, independent quiet window for the school day. */
    bool school_enabled;
    uint16_t school_start_min;
    uint16_t school_end_min;
    uint8_t school_days;   /* bit0 = Monday .. bit6 = Sunday; 0 = every day */
} tag_config_t;

typedef struct {
    uint8_t fw_major, fw_minor, fw_patch;
    uint8_t hw_rev;
    uint16_t pack_id;
    uint16_t pack_version;
    uint8_t battery;
    uint16_t uptime_min;
    uint8_t flags;
} tag_info_t;

typedef struct {
    uint8_t version;
    tag_event_type_t type;
    uint32_t uptime_sec;
    uint8_t battery;
    uint8_t aux;
} tag_event_frame_t;

typedef enum {
    TAG_CTRL_IDENTIFY = 0x01,
    TAG_CTRL_PREVIEW = 0x02,
    TAG_CTRL_MUTE = 0x03,
    TAG_CTRL_SET_TIME = 0x04,
    TAG_CTRL_FACTORY_RESET = 0x05,
    TAG_CTRL_ENTER_DFU = 0x06
} tag_control_op_t;

typedef struct {
    tag_control_op_t op;
    uint16_t arg;               /* minutes for MUTE/SET_TIME */
    tag_event_type_t preview;   /* for PREVIEW */
    /*
     * SET_TIME only. The wire encodes 0 = Monday .. 6 = Sunday, so a
     * zero-initialised struct would silently mean "Monday". An explicit flag
     * keeps the safe value the default: no flag, no weekday byte.
     */
    bool has_day_of_week;
    uint8_t day_of_week;        /* 0 = Monday .. 6 = Sunday */
} tag_control_t;

typedef enum {
    TAG_OK = 0,
    TAG_ERR_LENGTH = -1,
    TAG_ERR_VERSION = -2,
    TAG_ERR_CHECKSUM = -3,
    TAG_ERR_VALUE = -4
} tag_status_t;

/** XOR of the first `len` bytes — the config frame's integrity check. */
uint8_t tag_xor_checksum(const uint8_t *bytes, size_t len);

/** Writes TAGALONG_CONFIG_LEN bytes. Returns TAG_OK or TAG_ERR_VALUE. */
tag_status_t tag_config_encode(const tag_config_t *cfg, uint8_t *out, size_t out_len);
tag_status_t tag_config_decode(const uint8_t *in, size_t in_len, tag_config_t *out);

tag_status_t tag_info_encode(const tag_info_t *info, uint8_t *out, size_t out_len);
tag_status_t tag_info_decode(const uint8_t *in, size_t in_len, tag_info_t *out);

tag_status_t tag_event_encode(const tag_event_frame_t *ev, uint8_t *out, size_t out_len);
tag_status_t tag_event_decode(const uint8_t *in, size_t in_len, tag_event_frame_t *out);

/** Returns the number of bytes written (1..3), or a negative tag_status_t. */
int tag_control_encode(const tag_control_t *ctrl, uint8_t *out, size_t out_len);
tag_status_t tag_control_decode(const uint8_t *in, size_t in_len, tag_control_t *out);

/** True if `event` is a code this firmware knows. */
bool tag_event_is_known(uint8_t code);

/** True when `minute_of_day` is inside a window, handling wrap past midnight. */
bool tag_minute_in_window(uint16_t minute_of_day, uint16_t start_min, uint16_t end_min);

/**
 * True when the tag must stay silent: inside the night window, or inside the
 * school window on a day the school mask covers.
 * `day_of_week` is 0 for Monday .. 6 for Sunday; pass TAG_DAY_UNKNOWN when the
 * tag has not been told the day, in which case the school mask is ignored.
 */
#define TAG_DAY_UNKNOWN 0xFFu
bool tag_in_quiet_hours(const tag_config_t *cfg, uint16_t minute_of_day, uint8_t day_of_week);

#endif /* TAGALONG_PROTOCOL_H */
```

## src/tagalong_events.c
```c
#include "tagalong_events.h"

#include <string.h>

/* ---------------------------------------------------------------- helpers */

/* Integer square root, so the engine needs no floating point or libm. */
static uint32_t isqrt32(uint32_t v)
{
    uint32_t rem = 0, root = 0;
    for (int i = 0; i < 16; i++) {
        root <<= 1;
        rem = (rem << 2) | (v >> 30);
        v <<= 2;
        if (root < rem) {
            rem -= root | 1u;
            root += 2u;
        }
    }
    return root >> 1;
}

uint16_t tag_accel_magnitude(const tag_accel_sample_t *s)
{
    int32_t x = s->x, y = s->y, z = s->z;
    uint32_t sq = (uint32_t)(x * x) + (uint32_t)(y * y) + (uint32_t)(z * z);
    uint32_t m = isqrt32(sq);
    return (uint16_t)(m > UINT16_MAX ? UINT16_MAX : m);
}

/*
 * Tilt from vertical, using a small lookup rather than acos(). Upright means the
 * gravity vector lies along +z; we compare |z| against the magnitude.
 */
int16_t tag_accel_tilt_degrees(const tag_accel_sample_t *s)
{
    uint16_t mag = tag_accel_magnitude(s);
    if (mag == 0u) return 0;
    int32_t az = s->z < 0 ? -s->z : s->z;
    uint32_t ratio = (uint32_t)((az * 100) / mag); /* cos(theta) x100 */
    /* cos table, 0..90 degrees in 5-degree steps, x100 */
    static const uint8_t cos5[19] = { 100, 99, 98, 96, 93, 90, 86, 81, 76, 70,
                                      64, 57, 50, 42, 34, 25, 17, 8, 0 };
    for (int i = 0; i < 19; i++) {
        if (ratio >= cos5[i]) return (int16_t)(i * 5);
    }
    return 90;
}

static void emit(tag_event_batch_t *out, tag_event_type_t type, uint8_t aux)
{
    if (out->count >= TAG_MAX_EVENTS_PER_BLOCK) return;
    out->items[out->count].type = type;
    out->items[out->count].aux = aux;
    out->count++;
}

static bool elapsed_at_least(uint32_t now, uint32_t since, uint32_t span)
{
    if (since == 0u) return true;
    return (uint32_t)(now - since) >= span;
}

/* ------------------------------------------------------------------- init */

void tag_events_set_time(tag_event_engine_t *e, uint16_t minute_of_day, uint32_t now_ms)
{
    if (!e || minute_of_day > 1439u) return;
    /* Time going backwards means a new day: reset the per-day allowances. */
    if (e->time_known && minute_of_day < e->minute_of_day) {
        e->brush_sessions_today = 0u;
        e->left_behind_today = false;
    }
    e->minute_of_day = minute_of_day;
    e->time_known = true;
    e->time_set_at_ms = now_ms;
}

/** Minute of day advanced by the elapsed milliseconds since the last sync. */
static uint16_t current_minute(const tag_event_engine_t *e, uint32_t now_ms)
{
    uint32_t elapsed_min = (now_ms - e->time_set_at_ms) / 60000u;
    return (uint16_t)((e->minute_of_day + elapsed_min) % 1440u);
}

void tag_events_init(tag_event_engine_t *e, tag_thing_t thing, uint32_t now_ms)
{
    memset(e, 0, sizeof(*e));
    e->thing = thing;
    e->motion = TAG_MOTION_STILL;
    e->state_since_ms = now_ms;
    e->last_motion_ms = now_ms;
    e->boot_ms = now_ms;
    e->last_lux = TAG_LUX_NONE;
    e->cap_low_pct = 100u;
}

/* ------------------------------------------------------------ block stats */

typedef struct {
    uint16_t mean_mag;
    uint32_t variance;
    uint16_t peak_mag;
    uint16_t min_mag;
    uint8_t crossings;    /* sign changes of (mag - mean), a proxy for oscillation */
    int16_t tilt_deg;     /* from the last sample */
} block_stats_t;

static void compute_stats(const tag_sensor_block_t *b, block_stats_t *st)
{
    memset(st, 0, sizeof(*st));
    if (b->n == 0u || b->samples == NULL) return;

    uint32_t sum = 0;
    uint16_t peak = 0, lo = UINT16_MAX;
    for (uint16_t i = 0; i < b->n; i++) {
        uint16_t m = tag_accel_magnitude(&b->samples[i]);
        sum += m;
        if (m > peak) peak = m;
        if (m < lo) lo = m;
    }
    uint16_t mean = (uint16_t)(sum / b->n);

    uint64_t var_acc = 0;
    uint8_t crossings = 0;
    int last_sign = 0;
    for (uint16_t i = 0; i < b->n; i++) {
        int32_t d = (int32_t)tag_accel_magnitude(&b->samples[i]) - (int32_t)mean;
        var_acc += (uint64_t)(d * d);
        int sign = d > 60 ? 1 : (d < -60 ? -1 : 0);
        if (sign != 0 && last_sign != 0 && sign != last_sign) crossings++;
        if (sign != 0) last_sign = sign;
    }

    st->mean_mag = mean;
    st->variance = (uint32_t)(var_acc / b->n);
    st->peak_mag = peak;
    st->min_mag = lo;
    st->crossings = crossings;
    st->tilt_deg = tag_accel_tilt_degrees(&b->samples[b->n - 1u]);
}

/* ------------------------------------------------------------ classifiers */

static void detect_drop(tag_event_engine_t *e, const tag_sensor_block_t *b,
                        const block_stats_t *st, tag_event_batch_t *out)
{
    if (b->n == 0u) return;

    /* Stage 1: free-fall, every axis near zero for long enough. */
    if (st->min_mag < TAG_FREEFALL_MILLI_G) {
        if (!e->in_freefall) {
            e->in_freefall = true;
            e->freefall_started_ms = b->now_ms;
        }
        return; /* still falling; the impact cannot be in this block */
    }
    if (e->in_freefall) {
        e->in_freefall = false;
        uint32_t fall_ms = b->now_ms - e->freefall_started_ms;
        /* Too short is a fast lowering, not a fall. */
        e->freefall_ended_ms = fall_ms >= TAG_FREEFALL_MIN_MS ? b->now_ms : 0u;
    }

    /* Stage 2: an impact shortly after a real fall. Impact alone is just a firm putdown. */
    if (e->freefall_ended_ms == 0u) return;
    if ((uint32_t)(b->now_ms - e->freefall_ended_ms) > TAG_IMPACT_WINDOW_MS) {
        e->freefall_ended_ms = 0u;
        return;
    }
    if (st->peak_mag < TAG_IMPACT_MILLI_G) return;
    if (!elapsed_at_least(b->now_ms, e->last_drop_ms, 3000u)) return;

    uint32_t g_x10 = (uint32_t)st->peak_mag / 100u;
    emit(out, TAG_EVT_DROP, (uint8_t)(g_x10 > 255u ? 255u : g_x10));
    e->last_drop_ms = b->now_ms;
    e->freefall_ended_ms = 0u;
}

static void detect_motion(tag_event_engine_t *e, const tag_sensor_block_t *b,
                          const block_stats_t *st, tag_event_batch_t *out)
{
    if (b->n == 0u) return;

    bool moving = st->variance > TAG_MOVING_VAR;
    bool still = st->variance < TAG_STILL_VAR;

    /*
     * "The room was busy" has to mean recently busy. Without decay the counter
     * only ever grows, so every backpack that has been picked up three times in
     * its life qualifies, and left-behind fires after any ordinary putdown.
     */
    if (e->recent_transitions > 0u &&
        (uint32_t)(b->now_ms - e->last_transition_ms) > TAG_TRANSITION_DECAY_MS) {
        e->recent_transitions = 0u;
    }

    /*
     * Vehicle rejection. Road vibration reads as movement by variance alone, so
     * the discriminator is regularity over time: a car oscillates steadily for
     * minutes, a child handling a bottle does not. Once transport is confirmed,
     * pickup/putdown/shake are suppressed until the tag is genuinely still again,
     * otherwise the tag chats for an entire journey.
     */
    bool oscillatory = st->crossings >= 6u && st->peak_mag < 2200;
    uint32_t block_ms = b->sample_rate_hz ? (uint32_t)((b->n * 1000u) / b->sample_rate_hz) : 320u;
    if (oscillatory) {
        uint32_t needed = block_ms ? (TAG_TRANSPORT_CONFIRM_MS / block_ms) : 32u;
        if (e->oscillatory_blocks < UINT16_MAX) e->oscillatory_blocks++;
        if (e->oscillatory_blocks >= needed) e->transport_suppressed = true;
    } else if (!moving) {
        e->oscillatory_blocks = 0u;
    }
    if (still) {
        e->transport_suppressed = false;
        e->oscillatory_blocks = 0u;
    }

    if (moving) e->last_motion_ms = b->now_ms;

    if (e->motion == TAG_MOTION_STILL) {
        if (moving) {
            if (e->state_since_ms == 0u) e->state_since_ms = b->now_ms;
            if ((uint32_t)(b->now_ms - e->state_since_ms) >= TAG_PICKUP_CONFIRM_MS) {
                e->motion = TAG_MOTION_HANDLED;
                e->state_since_ms = b->now_ms;
                if (e->recent_transitions < 255u) e->recent_transitions++;
                e->last_transition_ms = b->now_ms;
                /* A drop in the same breath already told the story; don't stack. */
                if (!e->transport_suppressed &&
                    elapsed_at_least(b->now_ms, e->last_drop_ms, 2000u)) {
                    emit(out, TAG_EVT_PICKUP, 0);
                }
            }
        } else {
            e->state_since_ms = b->now_ms;
        }
    } else { /* HANDLED */
        if (still) {
            if ((uint32_t)(b->now_ms - e->last_motion_ms) >= TAG_PUTDOWN_CONFIRM_MS) {
                e->motion = TAG_MOTION_STILL;
                e->state_since_ms = b->now_ms;
                if (e->recent_transitions < 255u) e->recent_transitions++;
                e->last_transition_ms = b->now_ms;
                if (!e->transport_suppressed) emit(out, TAG_EVT_PUTDOWN, 0);
            }
        } else {
            e->state_since_ms = b->now_ms;
        }
    }

    /*
     * Shake: a deliberate, energetic wiggle. Brushing is a strict superset of
     * this signature, so a toothbrush would shout "shake" all the way through a
     * two-minute clean and never reach the celebration. A toothbrush therefore
     * has no shake event at all; brushing is what shaking a toothbrush means.
     */
    if (e->thing != TAG_THING_TOOTHBRUSH && !e->brushing && !e->transport_suppressed &&
        st->crossings >= TAG_SHAKE_MIN_CROSSINGS && st->peak_mag > TAG_SHAKE_PEAK_MILLI_G &&
        elapsed_at_least(b->now_ms, e->last_shake_ms, TAG_SHAKE_DEBOUNCE_MS)) {
        emit(out, TAG_EVT_SHAKE, 0);
        e->last_shake_ms = b->now_ms;
    }

    /* Long still: curious, not nagging, and rate-limited hard. */
    if ((uint32_t)(b->now_ms - e->last_motion_ms) >= TAG_LONG_STILL_MS &&
        elapsed_at_least(b->now_ms, e->last_long_still_ms, 4u * 3600000u)) {
        emit(out, TAG_EVT_LONG_STILL, 0);
        e->last_long_still_ms = b->now_ms;
    }
}

static void detect_bottle(tag_event_engine_t *e, const tag_sensor_block_t *b,
                          const block_stats_t *st, tag_event_batch_t *out)
{
    if (b->cap_raw == TAG_CAP_NONE) return;

    /* Learn the empty baseline and the full span from what we actually see. */
    if (e->cap_span == 0u) {
        if (e->cap_baseline == 0u || b->cap_raw < e->cap_baseline) e->cap_baseline = b->cap_raw;
        if (b->cap_raw > e->cap_baseline + 80u) e->cap_span = (uint16_t)(b->cap_raw - e->cap_baseline);
        return; /* no confident level yet */
    }
    if (b->cap_raw > (uint32_t)e->cap_baseline + e->cap_span) {
        e->cap_span = (uint16_t)(b->cap_raw - e->cap_baseline);
    }

    uint16_t level = 0u;
    if (b->cap_raw > e->cap_baseline) {
        uint32_t pct = ((uint32_t)(b->cap_raw - e->cap_baseline) * 100u) / e->cap_span;
        level = (uint16_t)(pct > 100u ? 100u : pct);
    }
    uint16_t previous = e->cap_level_pct;
    e->cap_level_pct = level;
    if (level < e->cap_low_pct) e->cap_low_pct = level;

    /* Fill: a clear rise, then stillness. Sloshing rises and keeps moving. */
    if (level > previous + TAG_FILL_RISE_PERCENT) {
        e->fill_armed = true;
        e->cap_rise_start_ms = b->now_ms;
        e->cap_rise_from_pct = previous;
    }
    if (e->fill_armed) {
        bool still = st->variance < TAG_STILL_VAR || b->n == 0u;
        bool settled = still && (uint32_t)(b->now_ms - e->cap_rise_start_ms) >= 2000u;
        bool expired = (uint32_t)(b->now_ms - e->cap_rise_start_ms) > 10000u;
        if (settled && level >= TAG_FILL_FULL_PERCENT && e->cap_low_pct < 40u &&
            elapsed_at_least(b->now_ms, e->last_fill_ms, 60000u)) {
            emit(out, TAG_EVT_FILLED, (uint8_t)level);
            e->last_fill_ms = b->now_ms;
            e->fill_armed = false;
            e->cap_low_pct = level;
        } else if (expired) {
            e->fill_armed = false;
        }
    }

    /* Empty: only once the bottle has actually been used since the last fill. */
    if (level <= TAG_EMPTY_PERCENT && previous > TAG_EMPTY_PERCENT && e->last_fill_ms != 0u) {
        emit(out, TAG_EVT_EMPTY, 0);
    }
}

static void detect_sip(tag_event_engine_t *e, const tag_sensor_block_t *b,
                       const block_stats_t *st, tag_event_batch_t *out)
{
    if (b->n == 0u) return;

    if (!e->tilted) {
        if (st->tilt_deg >= TAG_SIP_TILT_DEG) {
            e->tilted = true;
            e->tilt_started_ms = b->now_ms;
            e->tilt_peak_deg = st->tilt_deg;
            e->tilt_start_level_pct = e->cap_level_pct;
        }
        return;
    }

    if (st->tilt_deg > e->tilt_peak_deg) e->tilt_peak_deg = st->tilt_deg;

    if (st->tilt_deg <= TAG_SIP_UPRIGHT_DEG) {
        uint32_t held = b->now_ms - e->tilt_started_ms;
        e->tilted = false;
        if (held < TAG_SIP_MIN_MS || held > TAG_SIP_MAX_MS) return;
        /* On a bottle with working cap sensing, require the level to actually drop. */
        if (e->cap_span != 0u && e->cap_level_pct + 3u > e->tilt_start_level_pct) return;
        uint8_t deg = (uint8_t)(e->tilt_peak_deg > 255 ? 255 : e->tilt_peak_deg);
        emit(out, TAG_EVT_SIP, deg);
    } else if ((uint32_t)(b->now_ms - e->tilt_started_ms) > TAG_SIP_MAX_MS * 3u) {
        e->tilted = false; /* stored on its side; not a sip */
    }
}

static void detect_toothbrush(tag_event_engine_t *e, const tag_sensor_block_t *b,
                              const block_stats_t *st, tag_event_batch_t *out)
{
    if (b->n == 0u) return;

    /* Brushing is a narrowband oscillation with real energy behind it. */
    bool active = st->crossings >= 5u && st->peak_mag > 1150 && st->variance > 20000u;
    uint32_t block_ms = (uint32_t)((b->n * 1000u) / (b->sample_rate_hz ? b->sample_rate_hz : 200u));

    if (active) {
        if (!e->brushing) {
            bool new_session = e->brush_last_active_ms == 0u ||
                               (uint32_t)(b->now_ms - e->brush_last_active_ms) >
                                   TAG_BRUSH_SESSION_RESET_MS;
            if (new_session) {
                e->brush_session_start_ms = b->now_ms;
                e->brush_accum_ms = 0u;
                e->brush_announced_start = false;
                e->brush_announced_done = false;
            }
            e->brushing = true;
        }
        e->brush_accum_ms += block_ms;
        e->brush_last_active_ms = b->now_ms;

        /* Two announced sessions a day is a morning and an evening. Beyond that
         * the tag keeps counting but stops celebrating, so the brush cannot be
         * turned into a toy that pays out. */
        bool may_announce = e->brush_sessions_today < TAG_BRUSH_MAX_SESSIONS_PER_DAY;

        if (!e->brush_announced_start && e->brush_accum_ms >= 4000u) {
            if (may_announce) emit(out, TAG_EVT_BRUSH_START, 0);
            e->brush_announced_start = true;
        }
        if (!e->brush_announced_done && e->brush_accum_ms >= TAG_BRUSH_TARGET_MS) {
            if (may_announce) {
                uint32_t half = e->brush_accum_ms / 2000u;
                emit(out, TAG_EVT_BRUSH_DONE, (uint8_t)(half > 255u ? 255u : half));
                if (e->brush_sessions_today < 255u) e->brush_sessions_today++;
            }
            e->brush_announced_done = true;
        }
        return;
    }

    if (e->brushing) e->brushing = false;

    /* Session ends after a real pause. Under 15 s of brushing says nothing at all. */
    if (e->brush_last_active_ms != 0u &&
        (uint32_t)(b->now_ms - e->brush_last_active_ms) > 20000u) {
        if (!e->brush_announced_done && e->brush_accum_ms >= TAG_BRUSH_SHORT_MIN_MS &&
            e->brush_accum_ms < TAG_BRUSH_TARGET_MS &&
            e->brush_sessions_today < TAG_BRUSH_MAX_SESSIONS_PER_DAY) {
            uint32_t half = e->brush_accum_ms / 2000u;
            emit(out, TAG_EVT_BRUSH_SHORT, (uint8_t)(half > 255u ? 255u : half));
            if (e->brush_sessions_today < 255u) e->brush_sessions_today++;
        }
        e->brush_last_active_ms = 0u;
        e->brush_accum_ms = 0u;
        e->brush_announced_start = false;
        e->brush_announced_done = false;
    }
}

static void detect_lunchbox(tag_event_engine_t *e, const tag_sensor_block_t *b,
                            tag_event_batch_t *out)
{
    if (b->lux == TAG_LUX_NONE) return;

    uint16_t previous = e->last_lux;
    e->last_lux = b->lux;
    if (previous == TAG_LUX_NONE) {
        if (b->lux < TAG_LUX_DARK) e->dark_since_ms = b->now_ms;
        return;
    }

    if (b->lux < TAG_LUX_DARK) {
        if (previous >= TAG_LUX_DARK) e->dark_since_ms = b->now_ms;
    }

    /* Open: a step into the light after being shut for a while. */
    if (!e->lid_open && previous < TAG_LUX_DARK && b->lux > TAG_LUX_OPEN &&
        e->dark_since_ms != 0u && (uint32_t)(b->now_ms - e->dark_since_ms) >= 5u * 60000u &&
        elapsed_at_least(b->now_ms, e->last_lid_ms, 30000u)) {
        emit(out, TAG_EVT_OPENED, 0);
        e->lid_open = true;
        e->last_lid_ms = b->now_ms;
    } else if (e->lid_open && b->lux < TAG_LUX_DARK &&
               elapsed_at_least(b->now_ms, e->last_lid_ms, 3000u)) {
        emit(out, TAG_EVT_CLOSED, 0);
        e->lid_open = false;
        e->last_lid_ms = b->now_ms;
    }
}

static void detect_backpack(tag_event_engine_t *e, const tag_sensor_block_t *b,
                            const block_stats_t *st, tag_event_batch_t *out)
{
    if (b->n == 0u) return;

    /* Zip: a short, fine, fast burst — distinct from a shake's big swings. */
    if (st->crossings >= 6u && st->peak_mag < 800 && st->peak_mag > 250 &&
        st->variance > 4000u && st->variance < TAG_MOVING_VAR) {
        emit(out, TAG_EVT_ZIPPED, 0);
        return;
    }

    /*
     * Left behind is the most dangerous event in the product: get it wrong and
     * the tag becomes a nag that the parent switches off for good. Every guard
     * has to hold: the room was recently busy, it then went quiet for a long
     * time, the clock is known, it is a leaving-the-house hour, and it has not
     * already fired today.
     */
    if (!e->time_known) return;               /* never guess at the hour */
    if (e->left_behind_today) return;
    if (e->recent_transitions < 3u) return;
    if ((uint32_t)(b->now_ms - e->last_motion_ms) < TAG_LEFT_BEHIND_MS) return;
    if (!elapsed_at_least(b->now_ms, e->last_left_behind_ms, 3u * 3600000u)) return;

    uint16_t minute = current_minute(e, b->now_ms);
    bool leaving_hour =
        (minute >= TAG_LEFT_BEHIND_MORNING_START && minute < TAG_LEFT_BEHIND_MORNING_END) ||
        (minute >= TAG_LEFT_BEHIND_AFTERNOON_START && minute < TAG_LEFT_BEHIND_AFTERNOON_END);
    if (!leaving_hour) return;

    emit(out, TAG_EVT_LEFT_BEHIND, 0);
    e->last_left_behind_ms = b->now_ms;
    e->last_left_behind_day_min = minute;
    e->left_behind_today = true;
    e->recent_transitions = 0u;
}

/* ---------------------------------------------------------------- process */

void tag_events_process(tag_event_engine_t *e, const tag_sensor_block_t *block,
                        tag_event_batch_t *out)
{
    out->count = 0u;
    if (e == NULL || block == NULL) return;

    /* Baselines need a moment to settle; a tag must not shout as it boots. */
    if (!e->warm) {
        if ((uint32_t)(block->now_ms - e->boot_ms) < TAG_WARMUP_MS) {
            block_stats_t warm_stats;
            compute_stats(block, &warm_stats);
            if (block->cap_raw != TAG_CAP_NONE && e->cap_baseline == 0u) {
                e->cap_baseline = block->cap_raw;
            }
            if (block->lux != TAG_LUX_NONE) e->last_lux = block->lux;
            if (warm_stats.variance > TAG_MOVING_VAR) e->last_motion_ms = block->now_ms;
            return;
        }
        e->warm = true;
    }

    block_stats_t st;
    compute_stats(block, &st);

    /* Order matters: a drop must be classified before the pickup that follows it. */
    detect_drop(e, block, &st, out);
    detect_motion(e, block, &st, out);

    switch (e->thing) {
    case TAG_THING_BOTTLE:
        detect_bottle(e, block, &st, out);
        detect_sip(e, block, &st, out);
        break;
    case TAG_THING_TOOTHBRUSH:
        detect_toothbrush(e, block, &st, out);
        break;
    case TAG_THING_LUNCHBOX:
        detect_lunchbox(e, block, out);
        break;
    case TAG_THING_BACKPACK:
        detect_backpack(e, block, &st, out);
        break;
    default:
        break; /* generic things use the common events only */
    }
}
```

## src/tagalong_policy.c
```c
#include "tagalong_policy.h"

#include <string.h>

#define MS_PER_HOUR 3600000u

uint32_t tag_event_debounce_ms(tag_event_type_t type)
{
    switch (type) {
    case TAG_EVT_DROP:         return 3000u;
    case TAG_EVT_SHAKE:        return 2000u;
    case TAG_EVT_TAP:          return 1000u;
    case TAG_EVT_PICKUP:
    case TAG_EVT_PUTDOWN:      return 2000u;
    case TAG_EVT_SIP:          return 20000u;
    case TAG_EVT_FILLED:       return 60000u;
    case TAG_EVT_EMPTY:        return 2u * 3600000u;
    case TAG_EVT_OPENED:
    case TAG_EVT_CLOSED:       return 30000u;
    case TAG_EVT_PACKED:       return 12u * 3600000u;
    case TAG_EVT_ZIPPED:       return 10000u;
    case TAG_EVT_LEFT_BEHIND:  return 3u * 3600000u;
    case TAG_EVT_LONG_STILL:   return 4u * 3600000u;
    case TAG_EVT_GOOD_MORNING: return 12u * 3600000u;
    case TAG_EVT_LOW_BATTERY:  return 24u * 3600000u;
    case TAG_EVT_CHARGING:     return 60000u;
    case TAG_EVT_BRUSH_START:
    case TAG_EVT_BRUSH_DONE:
    case TAG_EVT_BRUSH_SHORT:  return 5u * 60000u;
    default:                   return 1000u;
    }
}

bool tag_event_is_nudge(tag_event_type_t type)
{
    /* Events that ask the child for something. Off unless the parent opts in. */
    return type == TAG_EVT_EMPTY || type == TAG_EVT_LEFT_BEHIND || type == TAG_EVT_LONG_STILL;
}

static uint32_t max_tokens_milli(const tag_config_t *cfg)
{
    uint8_t per_hour = cfg->max_per_hour;
    if (per_hour < 1u) per_hour = 1u;
    if (per_hour > TAG_MAX_PER_HOUR_CAP) per_hour = TAG_MAX_PER_HOUR_CAP;
    return (uint32_t)per_hour * 1000u;
}

void tag_policy_init(tag_policy_t *p, const tag_config_t *cfg, uint32_t now_ms, uint32_t seed)
{
    memset(p, 0, sizeof(*p));
    p->tokens_milli = max_tokens_milli(cfg);
    p->tokens_updated_ms = now_ms;
    p->rng_state = seed ? seed : 0x9E3779B9u;
}

/** Tokens refill continuously: a full bucket per hour. */
static uint32_t tokens_now(const tag_policy_t *p, const tag_config_t *cfg, uint32_t now_ms)
{
    uint32_t cap = max_tokens_milli(cfg);
    uint32_t elapsed = now_ms - p->tokens_updated_ms; /* wraps correctly on uint32 */
    uint64_t refill = ((uint64_t)elapsed * cap) / MS_PER_HOUR;
    uint64_t tokens = (uint64_t)p->tokens_milli + refill;
    return tokens > cap ? cap : (uint32_t)tokens;
}

tag_speak_decision_t tag_policy_check(const tag_policy_t *p, const tag_config_t *cfg,
                                      const tag_policy_ctx_t *ctx, tag_event_type_t type)
{
    if (!tag_event_is_known((uint8_t)type)) return TAG_DENY_UNKNOWN_EVENT;

    /* Below 5% the tag stays silent but stays connectable, so the app can still warn. */
    if (ctx->battery <= 5u && type != TAG_EVT_CHARGING) return TAG_DENY_BATTERY_CRITICAL;

    if (ctx->muted) return TAG_DENY_MUTED;

    if (tag_in_quiet_hours(cfg, ctx->minute_of_day, ctx->day_of_week)) return TAG_DENY_QUIET_HOURS;

    if (tag_event_is_nudge(type) && !(cfg->flags & TAG_FLAG_NUDGES)) return TAG_DENY_NUDGES_OFF;

    /* Never talk over ourselves. */
    if (p->last_utterance_ms != 0u && (ctx->now_ms - p->last_utterance_ms) < TAG_MIN_GAP_MS) {
        return TAG_DENY_MIN_GAP;
    }

    uint32_t last = p->last_event_ms[(uint8_t)type];
    if (last != 0u && (ctx->now_ms - last) < tag_event_debounce_ms(type)) return TAG_DENY_DEBOUNCE;

    if (tokens_now(p, cfg, ctx->now_ms) < 1000u) return TAG_DENY_RATE_LIMIT;

    return TAG_SPEAK_ALLOW;
}

void tag_policy_commit(tag_policy_t *p, const tag_config_t *cfg, const tag_policy_ctx_t *ctx,
                       tag_event_type_t type)
{
    uint32_t tokens = tokens_now(p, cfg, ctx->now_ms);
    p->tokens_milli = tokens >= 1000u ? tokens - 1000u : 0u;
    p->tokens_updated_ms = ctx->now_ms;
    p->last_event_ms[(uint8_t)type] = ctx->now_ms ? ctx->now_ms : 1u;
    p->last_utterance_ms = ctx->now_ms ? ctx->now_ms : 1u;
}

uint32_t tag_policy_rand(tag_policy_t *p)
{
    uint32_t x = p->rng_state;
    x ^= x << 13;
    x ^= x >> 17;
    x ^= x << 5;
    p->rng_state = x;
    return x;
}

uint16_t tag_policy_pick_clip(tag_policy_t *p, uint16_t count)
{
    if (count == 0u) return 0u;

    /* Build the pool of clips not played recently, exactly like the app does. */
    uint16_t pool[256];
    uint16_t pool_len = 0u;
    uint16_t limit = count < 256u ? count : 256u;
    for (uint16_t i = 0u; i < limit; i++) {
        bool recent = false;
        for (uint8_t r = 0u; r < p->recent_count; r++) {
            if (p->recent[r] == i) { recent = true; break; }
        }
        if (!recent) pool[pool_len++] = i;
    }
    /* Everything was recent: fall back to the whole set rather than repeating the last one. */
    if (pool_len == 0u) {
        for (uint16_t i = 0u; i < limit; i++) pool[pool_len++] = i;
    }

    uint16_t chosen = pool[tag_policy_rand(p) % pool_len];

    if (p->recent_count < TAG_RECENT_MEMORY) {
        p->recent[p->recent_count++] = chosen;
    } else {
        for (uint8_t i = 1u; i < TAG_RECENT_MEMORY; i++) p->recent[i - 1u] = p->recent[i];
        p->recent[TAG_RECENT_MEMORY - 1u] = chosen;
    }
    return chosen;
}
```
